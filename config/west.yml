## config/west.yml
```yaml
manifest:
  remotes:
    - name: zmkfirmware
      url-base: https://github.com/zmkfirmware
    - name: electronicmaterialsoffice
      url-base: https://github.com/electronicmaterialsoffice
  projects:
    - name: zmk
      remote: electronicmaterialsoffice
      revision: main
      import: app/west.yml
  self:
    path: config
```
